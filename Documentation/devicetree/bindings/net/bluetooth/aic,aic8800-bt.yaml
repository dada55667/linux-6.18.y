## Documentation/devicetree/bindings/net/bluetooth/aic,aic8800-bt.yaml
```yaml
# SPDX-License-Identifier: (GPL-2.0 OR BSD-2-Clause)
%YAML 1.2
---
$id: http://devicetree.org/schemas/net/bluetooth/aic,aic8800-bt.yaml#
$schema: http://devicetree.org/meta-schemas/core.yaml#

title: AIC8800 Bluetooth controller

description:
  This binding describes the Bluetooth portion of the AIC8800 WiFi/BT combo
  chip. The Bluetooth side is a plain H4 HCI stream over a 4-wire UART,
  attached through a serdev node. The Bluetooth firmware is loaded by the
  WiFi driver of the same combo chip.

maintainers:
  - AICSemi <aic@aicsemi.com>

allOf:
  - $ref: bluetooth-controller.yaml#

properties:
  compatible:
    const: aic,aic8800-bt

  enable-gpios:
    maxItems: 1
    description:
      GPIO connected to the BT_REG_ON pin of the chip. Asserted to power on
      the Bluetooth subsystem.

  device-wakeup-gpios:
    maxItems: 1
    description:
      GPIO connected to the HOST_WAKE_BT pin. Asserted by the host to wake
      up the Bluetooth controller.

  host-wakeup-gpios:
    maxItems: 1
    description:
      GPIO connected to the BT_WAKE_HOST pin. Used by the controller to wake
      up the host.

  max-speed:
    $ref: /schemas/types.yaml#/definitions/uint32
    default: 115200
    description:
      UART baudrate used for the HCI link.

  post-power-on-delay-ms:
    $ref: /schemas/types.yaml#/definitions/uint32
    default: 100
    description:
      Delay in milliseconds after asserting enable-gpios before the UART is
      opened.

required:
  - compatible

unevaluatedProperties: false

examples:
  - |
    #include <dt-bindings/gpio/gpio.h>

    serial {
        bluetooth {
            compatible = "aic,aic8800-bt";
            enable-gpios = <&gpio1 17 GPIO_ACTIVE_HIGH>;
            device-wakeup-gpios = <&gpio1 16 GPIO_ACTIVE_HIGH>;
            host-wakeup-gpios = <&gpio1 18 GPIO_ACTIVE_HIGH>;
            max-speed = <115200>;
            post-power-on-delay-ms = <100>;
        };
    };
```

## Documentation/devicetree/bindings/net/wireless/aic,aic8800-sdio.yaml
```yaml
# SPDX-License-Identifier: (GPL-2.0 OR BSD-2-Clause)
%YAML 1.2
---
$id: http://devicetree.org/schemas/net/wireless/aic,aic8800-sdio.yaml#
$schema: http://devicetree.org/meta-schemas/core.yaml#

title: AIC8800 WiFi SDIO controller

description:
  This binding describes the WiFi portion of the AIC8800 WiFi/BT combo chip,
  attached via SDIO. The Bluetooth portion is described in a separate
  binding (aic,aic8800-bt.yaml).

maintainers:
  - AICSemi <aic@aicsemi.com>

allOf:
  - $ref: /schemas/net/wireless/wireless-controller.yaml#

properties:
  compatible:
    const: aic,aic8800-sdio

  reg:
    description: SDIO function number, usually 1.
    maxItems: 1

  interrupts:
    maxItems: 1
    description:
      Out-of-band (OOB) IRQ line for waking up the host in response to WLAN
      activity. This corresponds to the WIFI_WAKE_HOST line of the chip.

  interrupt-names:
    const: host-wake

required:
  - compatible
  - reg

unevaluatedProperties: false

examples:
  - |
    #include <dt-bindings/interrupt-controller/irq.h>

    mmc {
        #address-cells = <1>;
        #size-cells = <0>;

        wifi@1 {
            compatible = "aic,aic8800-sdio";
            reg = <1>;
            interrupt-parent = <&gpio1>;
            interrupts = <7 IRQ_TYPE_LEVEL_HIGH>;
            interrupt-names = "host-wake";
        };
    };
```

## drivers/bluetooth/aic_btusb/Kconfig
```kconfig
config AIC8800_BTUSB_SUPPORT
	tristate "AIC8800 USB bluetooth Support"
	depends on USB
	help
	  This is support for aic8800 usb bluetooh driver.
```

## drivers/net/wireless/aicsemi/aic8800/usb/Kconfig
```kconfig
config AIC8800_USB_WLAN
	bool "AIC8800 USB WLAN Support"
	default y
	depends on AIC8800_SUPPORT
	depends on USB
	help
	  Support AICSemi AIC8800 USB wireless.

config AIC8800_USB_FW_PATH
	string "Firmware & config file path"
	default "/lib/firmware/aic8800_usb"
	depends on AIC8800_USB_WLAN
	help
	  Path to the firmware & config file.
```

## drivers/net/wireless/uwe5622/Kconfig
```kconfig
config SPARD_WLAN_SUPPORT
	bool "Unisoc wireless Support"
	select AW_WIFI_DEVICE_UWE5622 if ARCH_SUNXI
	select AW_BIND_VERIFY if ARCH_SUNXI
	select RK_WIFI_DEVICE_UWE5622 if ARCH_ROCKCHIP
	select AML_WIFI_DEVICE_UWE5621 if ARCH_MESON
	help
	  This is support for spreadtrum wireless chip (UWE5621/5622/5621DS).
	  On Amlogic (ARCH_MESON) boards, selects the
	  Amlogic BSP path (uwe5621_bsp_sdio).

if SPARD_WLAN_SUPPORT
source "drivers/net/wireless/uwe5622/unisocwcn/Kconfig"
source "drivers/net/wireless/uwe5622/unisocwifi/Kconfig"
source "drivers/net/wireless/uwe5622/tty-sdio/Kconfig"
endif
```
