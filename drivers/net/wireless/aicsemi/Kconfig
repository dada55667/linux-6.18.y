## drivers/net/wireless/aicsemi/Kconfig
```kconfig
config WLAN_VENDOR_AIC
        bool "AICSemi devices"
        default y
        help
          If you have a wireless card belonging to this class, say Y.

if WLAN_VENDOR_AIC
source "drivers/net/wireless/aicsemi/aic8800/Kconfig"
endif
```

## drivers/net/wireless/aicsemi/aic8800/Kconfig
```kconfig
config AIC8800_SUPPORT
    bool "AIC8800 Support"
    default y
    depends on WLAN_VENDOR_AIC
    help
      Support for AIC8800 series wireless chips.

if AIC8800_SUPPORT
source "drivers/net/wireless/aicsemi/aic8800/sdio/Kconfig"
source "drivers/net/wireless/aicsemi/aic8800/usb/Kconfig"
endif
```

## drivers/net/wireless/aicsemi/aic8800/sdio/Kconfig
```kconfig
config AIC8800_SDIO_WLAN
	bool "AIC8800 SDIO WLAN Support"
	default y
	depends on AIC8800_SUPPORT
	depends on MMC
	help
	  Support AICSemi AIC8800 SDIO wireless.

config AIC8800_SDIO_FW_PATH
	string "Firmware & config file path"
	default "/lib/firmware/aic8800_sdio"
	depends on AIC8800_SDIO_WLAN
	help
	  Path to the firmware & config file.
```
